;*******************ADC INITIALIZATION
;	VREF		IS ON PIN RA1
;	ADC IN		IS ON PIN RA2
;	CLOCK SET TO 16 MHZ
;	EXTERN ADC_INIT
;	NO VARIABLES
	
	
	
	
	
	
#include    <p12lf1822.inc>
	
	
	
	GLOBAL	ADC_INIT
	
	ERRORLEVEL  -302

    
	CODE
	
ADC_INIT
	
	BANKSEL	APFCON
	MOVLW	B'10001101'
	MOVWF	APFCON
	
OSCILLATOR
	
	BANKSEL OSCCON
	MOVLW   B'01111000'	    ; Set clock to 16 MHZ
	MOVWF   OSCCON
	
PIN_SETUP
	
	BANKSEL	LATA
	
	CLRF	LATA
	
	BANKSEL	TRISA
	
	MOVLW	B'00111111'
	MOVWF	TRISA
	
	BANKSEL	ANSELA
	
	MOVLW	B'00010111'
	MOVWF	ANSELA
    

	BANKSEL	    ADCON0
	
	MOVLW	    B'00000001'	;GO_nDONE stop; ADON enabled; CHS AN0
	MOVWF	    ADCON0
	
	BANKSEL	    ADCON1
	
	MOVLW	    B'00100000'
	MOVWF	    ADCON1	;ADFM left; ADPREF = AVDD ; ADCS FOSC/32
	
	BANKSEL	    ADRESL
	
	CLRF	    ADRESL
	CLRF	    ADRESH
	

	
CHANNEL_SELECT
	
	BANKSEL	    ADCON0
	
	MOVLW	    B'00001001'	; AN2 PIN RA2 INPUT
	MOVWF	    ADCON0
	
ADC_START
	    
	BANKSEL	    ADCON0
	
	BSF	    ADCON0 ,1
	
ADC_TEST
	    
	BANKSEL	    ADCON0
	
	BTFSC	    ADCON0 ,1
	GOTO	    ADC_TEST
	
	RETLW	    0
	
	
	END
	
