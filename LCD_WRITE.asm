#INCLUDE    <p12lf1822.inc>

 ERRORLEVEL  -305
 ERRORLEVEL  -302
 

	GLOBAL	TEST
	GLOBAL	DELAY
        GLOBAL  LCD_WRITE
        LOCAL   COUNT1
        LOCAL   COUNT2
	EXTERN	ONE
	EXTERN	TWO
	EXTERN	THREE
	
        UDATA

COUNT1  RES 1
COUNT2  RES 1

        CODE
	
	
TEST
    
    BANKSEL TXSTA
    BTFSS   TXSTA, TRMT	    ; Poll If Bit SET
    GOTO    TEST
    
    BANKSEL PIR1
    BTFSS   PIR1, TXIF
    GOTO    TEST
    
    RETLW   0
    
DELAY 
    
        MOVLW   D'255'
        MOVWF   COUNT1

	MOVLW	D'5'
	MOVWF   COUNT2

LOOP
        BANKSEL COUNT1
        DECFSZ  COUNT1
        GOTO    LOOP
        DECFSZ  COUNT2
        GOTO    LOOP

        RETLW   0


LCD_WRITE
	; Volts=_

        
	BANKSEL	TXREG
	MOVLW	D'22'	    ; CURSOR OFF NO CHARACTER BLINK
	MOVWF	TXREG
	
	CALL	TEST
	CALL	DELAY
	
	BANKSEL	TXREG
        MOVLW   D'86'       ; V
        MOVWF   TXREG
	
	CALL	TEST
	CALL	DELAY
	
	BANKSEL	TXREG
        MOVLW   D'111'       ; o
        MOVWF   TXREG
	
	CALL	TEST
	CALL	DELAY
	
	BANKSEL	TXREG
        MOVLW   D'108'       ; l
        MOVWF   TXREG
	
	CALL	TEST
	CALL	DELAY
	
	BANKSEL	TXREG
        MOVLW   D'116'       ; t
        MOVWF   TXREG
	
	CALL	TEST
	CALL	DELAY
	
	BANKSEL	TXREG
        MOVLW   D'115'       ; s
        MOVWF   TXREG
	
	CALL	TEST
	CALL	DELAY
	
	BANKSEL	TXREG
        MOVLW   D'61'       ; =
        MOVWF   TXREG
	
	CALL	TEST
	CALL	DELAY
	
	BANKSEL	TXREG
        MOVLW   D'32'       ; space
        MOVWF   TXREG
	
	CALL	TEST
	CALL	DELAY
	
	RETLW	0

	;134 LINE 0 POSITION 6
	;154 LINE 1 POSITION 6
        END

