    #include <p12lf1822.inc>
    
    ERRORLEVEL	-302
    ERRORLEVEL	-312
    
    GLOBAL  THIS
    GLOBAL  THAT
    GLOBAL  COUNT5
    GLOBAL  COUNT4	
    GLOBAL  COUNT3
    GLOBAL  ANSWER	
    GLOBAL  ANSWER2	
    GLOBAL  TEMP
    GLOBAL  TEST1
    GLOBAL  TEST2
    GLOBAL  TEMP2
    GLOBAL  NANSWER
    GLOBAL  ONE
    GLOBAL  TWO
    GLOBAL  THREE
    
    	UDATA	
	
THIS	RES 1
THAT	RES 1
COUNT4	RES 1
COUNT3	RES 1
ANSWER	RES 1
ANSWER2	RES 1
TEMP	RES 1	
COUNT5	RES 1
TEST1	RES 1
TEST2	RES 1
TEMP2	RES 1
NANSWER RES 1
ONE     RES 1
TWO     RES 1
THREE   RES 1
    
    EXTERN  ADC_LOOKUP_FIRST
    EXTERN  ADC_LOOKUP_SECOND
    EXTERN  ADC_LOOKUP_THIRD
    EXTERN  TEST
    EXTERN  DELAY
    EXTERN  LCD_WRITE
    EXTERN  USART_INIT
    EXTERN  ADC_INIT
  
  
    RADIX   DEC

	
RES_VECT  CODE    0x0000            ; processor reset vector
  
  GOTO    START
  TABLE3  DT	"GARTH IS AN AWESOME GUY"
    
                       ; go to beginning of program



MAIN_PROG CODE                      ; let linker place main program

START
   
    MOVLW	D'1'
    CALL	TABLE3
    CALL	DELAY		    ; GIVE LCD TIME TO TURN ON
    CALL	USART_INIT	    ; SET UP USART
    
WRITE

    
    BANKSEL	TXREG
    MOVLW	D'12'		    ; CLEAR SCREEN RETURN TO LINE 0
    MOVWF	TXREG
    
    CALL	DELAY		    ; 5 MS DELAY NEEDED BY LCD AFTER CLEAR
    CALL	DELAY
    
    BANKSEL	TXREG	
    MOVLW	D'17'	    ; TURN ON BACKLIGHT
    MOVWF	TXREG
    
    
    
    CALL	LCD_WRITE

    
ADC_COLLECT
    
    CLRWDT
    CALL	ADC_INIT    ; GET ADC RESULT IN ADRESH
    
    BANKSEL	ADRESH
    MOVF	ADRESH,	W   ; STORE ADRESH IN W
    BANKSEL	ANSWER
    MOVWF	ANSWER	    ; MOVE W TO ANSWER
    
    MOVLW	HIGH ADC_LOOKUP_FIRST
    MOVWF	PCLATH
    
    MOVF	ANSWER, W
    CALL	ADC_LOOKUP_FIRST
   
    BANKSEL	ONE
    MOVWF	ONE
   
    MOVLW	HIGH ADC_LOOKUP_SECOND
    MOVWF	PCLATH
    
    MOVF	ANSWER, W
    CALL	ADC_LOOKUP_SECOND
    
    BANKSEL	TWO
    MOVWF	TWO
    
    MOVLW	HIGH ADC_LOOKUP_THIRD
    MOVWF	PCLATH
    
    MOVF	ANSWER, W
    CALL	ADC_LOOKUP_THIRD
    
    BANKSEL	THREE
    MOVWF	THREE
    
CURSOR   

    CALL	USART_INIT
    
    BANKSEL 	TXREG
    MOVLW	D'135'	    ;135 LINE 0 POSITION 7
    MOVWF	TXREG
    
    CALL	TEST
    CALL	DELAY
    
    
    BANKSEL	ONE
    MOVF	ONE,	W   ; ONE
    BANKSEL	TXREG
    MOVWF	TXREG
    
    CALL	TEST
    CALL	DELAY
    
    BANKSEL 	TXREG
    MOVLW	D'46'	    ; DECIMAL POINT .
    MOVWF	TXREG
    
    CALL	TEST
    CALL	DELAY
    
    BANKSEL	TWO
    MOVF	TWO,	W   ; TWO
    BANKSEL	TXREG
    MOVWF	TXREG
    
    CALL	TEST
    CALL	DELAY
    
    BANKSEL	THREE
    MOVF	THREE,	W   ; THREE
    BANKSEL	TXREG
    MOVWF	TXREG
    
    CALL	TEST
    CALL	DELAY
    
    GOTO	ADC_COLLECT
    
        
    END
